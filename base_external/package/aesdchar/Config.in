## base_external/package/aesdchar/Config.in
```kconfig
config BR2_PACKAGE_AESDCHAR
	bool "aesdchar"
	help
	  Supports building and installing the aesdchar components into the root filesystem.
	  Used to understand buildroot external trees and build.
```
